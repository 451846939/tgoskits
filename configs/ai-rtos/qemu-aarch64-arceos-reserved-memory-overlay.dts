// Copyright 2026 The TGOSKits Authors
//
// SPDX-License-Identifier: Apache-2.0

/dts-v1/;
/plugin/;

/ {
    fragment@0 {
        target-path = "/";

        __overlay__ {
            #address-cells = <2>;
            #size-cells = <2>;

            reserved-memory {
                #address-cells = <2>;
                #size-cells = <2>;
                ranges;

                arceos@c0000000 {
                    reg = <0x0 0xc0000000 0x0 0x10000000>;
                    no-map;
                };
            };
        };
    };
};
